/*
  AETHER RADAR — Final Build
  ══════════════════════════════════════════════════
  Flash: HTML served as gzip (~3.8 KB) via html_gz.h
  Two files needed in same folder:
    • AETHER_RADAR.ino   ← this file
    • html_gz.h          ← generated by make_html_gz.py

  Board   : ESP32 (any variant)
  Libs    : WiFi, WebServer, DNSServer,
            BLEDevice, BLEUtils, BLEScan
  ══════════════════════════════════════════════════
*/

#include <WiFi.h>
#include <WebServer.h>
#include <DNSServer.h>
#include <BLEDevice.h>
#include <BLEUtils.h>
#include <BLEScan.h>

#include "html_gz.h"

/* ── Config ─────────────────────────────────── */

const char*     SSID     = "AETHER_RADAR";
const char*     PASS     = "12345678";
const IPAddress AP_IP(192, 168, 4, 1);
const byte      DNS_PORT = 53;

/* ── Globals ─────────────────────────────────── */

WebServer server(80);
DNSServer dnsServer;
BLEScan*  pBLEScan;

/* ── Handlers ────────────────────────────────── */

void handleRoot() {
  server.sendHeader("Content-Encoding", "gzip");
  server.sendHeader("Cache-Control",    "no-cache");
  server.send_P(200, "text/html",
                (const char*)HTML_GZ,
                HTML_GZ_LEN);
}

void handleCaptivePortal() {
  server.sendHeader("Location", "http://192.168.4.1", true);
  server.send(302, "text/plain", "");
}

void handleScan() {

  String json = "[";
  bool   first = true;

  /* WiFi scan */
  int n = WiFi.scanNetworks();
  for (int i = 0; i < n; i++) {
    if (!first) json += ",";
    first = false;
    String nm = WiFi.SSID(i);
    if (nm == "") nm = "UNKNOWN";
    nm.replace("\"", "\\\"");           // escape quotes
    nm.replace("\\", "\\\\");
    json += "{\"type\":\"wifi\",\"id\":\"w" + String(i) + "\","
            "\"name\":\"" + nm + "\","
            "\"rssi\":"   + String(WiFi.RSSI(i)) + "}";
  }
  WiFi.scanDelete();                    // free scan memory

  /* BLE scan — 2 s passive */
  BLEScanResults res = pBLEScan->start(2, false);
  int cnt = res.getCount();
  for (int i = 0; i < cnt; i++) {
    if (!first) json += ",";
    first = false;
    BLEAdvertisedDevice d = res.getDevice(i);
    String nm = d.getName().c_str();
    if (nm == "") nm = "BLE_DEVICE";
    nm.replace("\"", "\\\"");
    json += "{\"type\":\"ble\",\"id\":\"b" + String(i) + "\","
            "\"name\":\"" + nm + "\","
            "\"rssi\":"   + String(d.getRSSI()) + "}";
  }

  json += "]";
  server.send(200, "application/json", json);
}

/* ── Setup ───────────────────────────────────── */

void setup() {

  Serial.begin(115200);

  /* Access Point */
  WiFi.mode(WIFI_AP_STA);
  WiFi.softAPConfig(AP_IP, AP_IP, IPAddress(255, 255, 255, 0));
  WiFi.softAP(SSID, PASS);

  /* Catch-all DNS → triggers captive portal popup */
  dnsServer.start(DNS_PORT, "*", AP_IP);

  /* BLE */
  BLEDevice::init("");
  pBLEScan = BLEDevice::getScan();
  pBLEScan->setActiveScan(true);

  /* Routes */
  server.on("/",     handleRoot);
  server.on("/scan", handleScan);

  /* Captive portal intercepts (Android / iOS / Windows) */
  server.on("/generate_204",              handleCaptivePortal);
  server.on("/gen_204",                   handleCaptivePortal);
  server.on("/hotspot-detect.html",       handleCaptivePortal);
  server.on("/library/test/success.html", handleCaptivePortal);
  server.on("/ncsi.txt",                  handleCaptivePortal);
  server.on("/connecttest.txt",           handleCaptivePortal);
  server.onNotFound(handleCaptivePortal);

  server.begin();

  Serial.println(F("================================"));
  Serial.println(F("  AETHER RADAR READY"));
  Serial.print(F("  SSID : ")); Serial.println(SSID);
  Serial.print(F("  IP   : ")); Serial.println(AP_IP);
  Serial.println(F("  Phone auto-opens on connect."));
  Serial.println(F("================================"));
}

/* ── Loop ────────────────────────────────────── */

void loop() {
  dnsServer.processNextRequest();   // must come first
  server.handleClient();
}
